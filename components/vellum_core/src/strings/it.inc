    .language_name = "Italiano",
    .continue_reading = "CONTINUA A LEGGERE",
    .start_reading = "INIZIA A LEGGERE",
    .library_label = "LIBRERIA",
    .library = "Libreria",
    .all_books = "Tutti i libri",
    .settings = "Impostazioni",
    .not_started = "Non iniziato",
    .page_of = "Pagina %d di %d",
    .short_of = "%d di %d",
    .status_new = "Nuovo",
    .status_finished = "Letto",
    .hint_home = "Laterali: sposta · Accensione: apri",
    .hint_list = "Laterali: sposta · Accensione: apri · Home: indietro",
    .hint_settings = "Laterali: sposta · Accensione: cambia · Home: indietro",
    .reading = "Lettura",
    .menu_font = "Font dei menu",
    .menu_text = "Testo dei menu",
    .menu_text_names = {"Normale", "Grande"},
    .book_font = "Font del libro",
    .preview_label = "ANTEPRIMA",
    .language = "Lingua",
    .clock = "Orologio",
    .clock_24 = "24 ore",
    .clock_12 = "12 ore",
    .sleep_after = "Stop dopo",
    .sleep_names = {"5 min", "10 min", "30 min", "Mai"},
    .sleeping = "IN STOP",
    .wake_hint = "Premi Accensione per riattivare",
    .battery_empty = "Batteria scarica",
    .charge_hint = "Ricaricalo, poi premi Accensione",
    .text_size = "Dimensione testo",
    .size_names = {"Piccolo", "Medio", "Grande", "Molto grande"},
    .line_spacing = "Interlinea",
    .word_spacing = "Spazio tra parole",
    .spacing_names = {"Stretto", "Normale", "Ampio"},
    .margins = "Margini",
    .margin_names = {"Stretti", "Normali", "Ampi"},
    .alignment = "Allineamento",
    .justified = "Giustificato",
    .left = "A sinistra",
    .hyphenation = "Sillabazione",
    .on = "Sì",
    .off = "No",
    .add_books = "Aggiungi libri",
    .transfer_lead = "Invia libri EPUB, FB2 o TXT da telefono o PC.",
    .step_join = "1  CONNETTITI A QUESTA WI-FI",
    .network = "Rete",
    .password = "Password",
    .step_open = "2  APRI IN UN BROWSER",
    .scan_hint = "Oppure inquadra i codici con la fotocamera.",
    .received_label = "RICEVUTI",
    .waiting = "In attesa di libri…",
    .receiving = "Ricezione di %s",
    .card_full = "La scheda è piena.",
    .starting = "Avvio Wi-Fi…",
    .no_wifi = "Impossibile avviare il Wi-Fi. Torna indietro e riprova.",
    .no_card = "Inserisci una scheda SD per aggiungere libri.",
    .hint_transfer = "Home: fine",
    .updating = "Aggiornamento di Vellum · %d%%",
    .update_done = "Aggiornamento installato. Riavvio…",
    .update_not_vellum = "Quel file non è un aggiornamento di Vellum.",
    .update_broken = "Aggiornamento interrotto. Nulla è cambiato.",
    .contents = "Indice",
    .back_to_book = "Torna alla pagina",
    .to_home_screen = "Schermata Home",
    .add_bookmark = "Segna questa pagina",
    .remove_bookmark = "Rimuovi questo segnalibro",
    .bookmarks_label = "SEGNALIBRI",
    .chapters_label = "CAPITOLI",
    .chapter_n = "Capitolo %d",
    .battery = "Batteria",
    .on_battery = "A batteria",
    .page_turn_ms = "pagina %u ms",
    .charging = "In carica",
    .history_label = "ULTIMI 7 GIORNI",
    .estimates_label = "STIME",
    .time_left = "Tempo residuo",
    .while_reading = "Durante la lettura",
    .while_asleep = "In stop",
    .measuring = "Misurazione in corso",
    .per_hour = "%s%% all’ora",
    .per_day = "%s%% al giorno",
    .clock_unset =
        "L’orologio non è impostato, quindi non c’è ancora una cronologia. Apri Aggiungi libri e carica la "
        "pagina sul telefono una volta: così imposta l’orologio.",
    .hint_battery = "Accensione o Home: indietro",
    .front_light = "Luce frontale",
    .brightness = "Luminosità",
    .warmth = "Calore",
    .cool = "Fredda",
    .warm = "Calda",
    .done = "Fine",
    .hint_light = "Laterali: cambia · Accensione: avanti",
    .device_check = "Verifica dispositivo",
    .buttons_label = "TASTI",
    .key_names = {"Su", "Giù", "Home", "Accensione"},
    .touch_label = "TOCCO",
    .touch_here = "Tocca un punto qualsiasi dello schermo",
    .about_label = "QUESTO DISPOSITIVO",
    .device = "Modello",
    .screen = "Schermo",
    .memory_card = "Scheda di memoria",
    .wifi = "Wi-Fi",
    .free_memory = "Memoria libera",
    .version = "Versione",
    .present = "Sì",
    .missing = "Assente",
    .not_set = "Non impostato",
    .hint_check = "Premi tutti i tasti · Entrambi i lati: indietro",
    .updates = "Aggiornamenti",
    .this_version = "Vellum %s su questo lettore",
    .status_label = "STATO",
    .up_to_date = "Vellum è aggiornato.",
    .update_ready = "Vellum %s è pronto da installare.",
    .not_checked = "Non ancora verificato.",
    .checked_at = "Ultima verifica: %s",
    .checking = "Ricerca di una nuova versione…",
    .installing = "Installazione di Vellum %s · %d%%",
    .need_home_wifi = "Imposta il Wi-Fi di casa per cercare aggiornamenti.",
    .wifi_failed = "Impossibile connettersi al Wi-Fi di casa.",
    .server_failed = "Impossibile raggiungere il server.",
    .install_failed = "L’aggiornamento non è stato installato. Nulla è cambiato.",
    .check_now = "Verifica ora",
    .install_version = "Installa Vellum %s",
    .automatic = "Automatici",
    .auto_names = {"Di notte", "Chiedi prima", "No"},
    .auto_help = {"Alle 3:00, mentre il lettore è in stop, cerca una nuova versione e la installa.",
                  "Alle 3:00 cerca una nuova versione e te lo dice qui. Scegli tu quando installarla.",
                  "Il lettore non cerca nuove versioni da solo."},
    .night_needs = "Servono il Wi-Fi di casa e l’orologio, entrambi dal telefono (Wi-Fi di casa, sotto).",
    .home_wifi = "Wi-Fi di casa",
    .from_file = "Aggiorna da file",
    .hint_updates = "Accensione: scegli · Home: indietro",
    .setup_lead = "Imposta il Wi-Fi di casa o invia un aggiornamento.",
    .phone_label = "DAL TELEFONO",
    .waiting_phone = "In attesa del telefono…",
    .wifi_saved = "Wi-Fi di casa salvato: %s",
    .hint_setup = "Home: indietro",
    .update_notice = "Nuovo Vellum %s",
    .update_new = "Nuovo",
    .send_book = "Invia a un altro Vellum",
    .send_title = "Invia libro",
    .nearby_label = "LETTORI VICINI",
    .looking = "Ricerca di lettori vicini… Sull’altro Vellum, apri Aggiungi libri.",
    .sending_to = "Invio a %s",
    .sent_to = "Inviato a %s. Il libro ora è nella sua libreria.",
    .send_no_answer = "Nessuna risposta. Tieni vicini i due lettori, con Aggiungi libri aperto sull’altro.",
    .send_refused = "L’altro lettore sta ricevendo un altro libro.",
    .send_card_full = "La scheda di memoria dell’altro lettore è piena.",
    .send_corrupt = "Il libro è arrivato danneggiato. Riprova.",
    .send_unreadable = "Impossibile leggere questo libro dalla scheda.",
    .hint_send = "Laterali: sposta · Accensione: invia · Home: indietro",
    .hint_sending = "Home: annulla",
    .hint_sent = "Accensione: torna al libro",
    .hint_retry = "Accensione: riprova · Home: indietro",
    .peer_hint = "Anche un altro Vellum vicino può inviare libri qui: in un libro, apri Indice › Invia a un altro Vellum.",
    .store_link = "Libri gratis",
    .store_search_for = "Cerca libri gratis: \xE2\x80\x9C%s\xE2\x80\x9D",
    .store_title = "Libri gratis",
    .store_lead = "Classici gratis, con il Wi-Fi di casa",
    .store_demo = "Catalogo demo: il simulatore non ha internet",
    .store_abouts = {"Oltre 70.000 classici, in molte lingue", "Edizioni curate di classici"},
    .store_lists = {"Più popolari", "Aggiunti di recente", "In lituano", "Avventura", "Gialli", "Fantascienza",
                    "Per ragazzi", "Poesia", "Novità"},
    .store_loading = "Caricamento…",
    .store_earlier = "Libri precedenti",
    .store_more = "Altri libri",
    .store_empty = "Nessun libro qui.",
    .store_no_epub = "Questo libro non ha un EPUB da scaricare.",
    .store_download = "Scarica",
    .store_downloading = "Download… %d%%",
    .store_saved = "Salvato nella tua libreria.",
    .store_read_now = "Leggi ora",
    .store_back = "Torna all’elenco",
    .store_retry = "Riprova",
    .store_no_home_wifi = "Nessun Wi-Fi di casa. Impostalo in Impostazioni › Aggiornamenti › Wi-Fi di casa.",
    .store_no_server = "Impossibile raggiungere il catalogo. Riprova più tardi.",
    .store_broke_off = "Il download si è interrotto. Riprova.",
    .store_not_book = "Il sito ha inviato qualcosa che non è un libro.",
    .hint_store_busy = "Attendi…",
    .step_home = "1  SUL WI-FI DI CASA",
    .home_hint = "Connetti anche il telefono o il computer.",
    .scan_one_hint = "Oppure inquadra il codice con la fotocamera.",
    .use_own_network = "Usa la rete del lettore",
    .use_home_wifi = "Usa il Wi-Fi di casa: %s",
    .home_wifi_failed = "Impossibile connettersi al Wi-Fi di casa, quindi il lettore ha aperto la sua rete.",
    .sync_progress = "Sincronizza progressi",
    .sync_busy = "Sincronizzazione…",
    .sync_sent = "Inviato %d%%",
    .sync_moved = "Spostato al %d%%",
    .sync_up_to_date = "Aggiornato",
    .sync_errors = {"Nessun Wi-Fi di casa", "Errore Wi-Fi", "Nessun server", "Login errato", "Nome già usato"},
    .look_up_word = "Cerca una parola",
    .highlights_label = "EVIDENZIAZIONI",
    .highlight = "Evidenzia",
    .remove_highlight = "Togli evidenziazione",
    .close = "Chiudi",
    .save = "Salva",
    .cancel = "Annulla",
    .no_dictionary =
        "Nessun dizionario. Metti i file StarDict nella cartella dictionaries della scheda, o inviali da "
        "Aggiungi libri.",
    .not_in_dictionary = "Non è nel dizionario.",
    .preparing_dictionary = "Preparazione del dizionario…",
    .hint_pick_line = "Laterali: riga · Accensione: scegli · Home: indietro",
    .hint_pick_word = "Laterali: parola · Accensione: cerca · Home: indietro",
    .hint_extend = "Tocca l’ultima parola, o raggiungila con i tasti laterali.",
    .footer = "Piè di pagina",
    .footer_names = {"Numero di pagina", "Tempo nel capitolo", "Percentuale letta"},
    .footer_left = "%s alla fine del capitolo",
    .contents_left = "Circa %s nel capitolo · %s nel libro",
    .reading_stats = "Statistiche di lettura",
    .today_label = "OGGI",
    .week_label = "ULTIMI 7 GIORNI · MINUTI",
    .weekdays = {"Lun", "Mar", "Mer", "Gio", "Ven", "Sab", "Dom"},
    .this_month = "Questo mese",
    .reading_speed = "Velocità di lettura",
    .pages_an_hour = "%d pagine all’ora",
    .all_time = "In totale",
    .books_label = "LIBRI",
    .nothing_read = "Non hai ancora letto nulla. Il tempo di lettura appare qui mentre giri le pagine.",
    .stats_clock =
        "L’orologio non è impostato, quindi la lettura non è contata per giorno. Apri Aggiungi libri e carica "
        "la pagina sul telefono una volta: così imposta l’orologio.",
    .preview_text =
        "La sera era tranquilla, e il fiume portava lentamente gli ultimi riflessi del sole oltre i vecchi "
        "salici, mentre da qualche parte al di là del prato un cane abbaiò due volte e poi tacque.",
    .preview_language = "it",
    .sort_by = "Ordina: %s",
    .sort_names = {"Recenti", "Titolo", "Autore", "Aggiunti"},
    .search = "Cerca",
    .search_prompt = "Titolo o autore",
    .ok = "OK",
    .tab_all = "Tutti",
    .tab_reading = "In lettura",
    .tab_finished = "Letti",
    .new_shelf = "Nuovo scaffale",
    .shelf_name = "Nome dello scaffale",
    .rename = "Rinomina",
    .delete_shelf = "Elimina scaffale",
    .delete_again = "Premi di nuovo per eliminare",
    .shelf_empty =
        "Ancora nessun libro qui. Tieni premuto un libro in Tutti, o usa Aggiungi a scaffale nell’indice del libro.",
    .nothing_found = "Nessun libro per \xE2\x80\x9C%s\xE2\x80\x9D.",
    .no_books_here = "Ancora nessun libro qui.",
    .add_to_shelf = "Aggiungi a scaffale",
    .shelves = "Scaffali",
    .shelves_label = "SCAFFALI",
    .finished_reading = "Letto",
    .buttons = "Tasti",
    .button_pages = {"Durante la lettura", "Nei menu"},
    .input_names = {"Indietro", "Avanti", "Accensione", "Home", "Tieni Indietro", "Tieni Avanti", "Tieni Home"},
    .action_names = {"Niente",
                     "Pagina precedente",
                     "Pagina successiva",
                     "Capitolo precedente",
                     "Capitolo successivo",
                     "Indice",
                     "Schermata Home",
                     "Libreria",
                     "Segna pagina",
                     "Luce sì/no",
                     "Luce frontale",
                     "Pagine automatiche",
                     "Aggiornamento completo",
                     "Istantanea schermo",
                     "Stop",
                     "Su",
                     "Giù",
                     "Apri",
                     "Indietro",
                     "Pagina su",
                     "Pagina giù",
                     "Pannello rapido"},
    .reset_default = "Ripristina predefiniti",
    .power_hold_note = "Tenere premuto Accensione per un secondo mette sempre in stop.",
    .way_back_note =
        "Le scelte che non lascerebbero modo di raggiungere indice o Home, o di aprire, tornare indietro "
        "e muoversi nei menu, vengono saltate.",
    .screen_names = {"Verticale", "Capovolto", "Orizzontale, tasti a sinistra", "Orizzontale, tasti a destra"},
    .screen_note = "I libri ruotano in orizzontale quando li apri. I menu restano in verticale.",
    .auto_turn = "Pagine automatiche",
    .every_seconds = "Ogni %d s",
    .full_refresh = "Aggiornamento completo",
    .refresh_names = {"Ogni pagina", "Ogni 5 pagine", "Ogni 12 pagine", "Ogni 20 pagine", "Nuovo capitolo"},
    .start_auto_turn = "Gira pagina ogni %d s",
    .auto_turn_on = "Le pagine girano ogni %d s",
    .auto_turn_off = "Pagine automatiche ferme",
    .screenshot_saved = "Salvata %s",
    .screenshot_failed = "Nessuna istantanea: manca la scheda?",
    .sleep_screen = "Schermata di stop",
    .sleep_kinds = {"Copertina", "Le mie immagini", "Statistiche", "Minimale", "Pagina com’è"},
    .sleep_help = {"La copertina del libro che stai leggendo.", "Le tue immagini, dalla cartella sleep.",
                   "I tuoi progressi e il tempo di lettura.", "Il titolo del libro su una pagina sobria.",
                   "Resta l’ultima schermata, segnata come in stop."},
    .pictures_label = "LE MIE IMMAGINI",
    .sleep_order = "Immagini",
    .sleep_order_names = {"Casuale", "Una sola"},
    .choose_pictures = "Scegli immagini",
    .preview = "Anteprima",
    .no_pictures =
        "Ancora nessuna immagine. Metti file JPG, PNG o BMP nella cartella sleep della scheda, o inviali "
        "dalla pagina del telefono di Aggiungi libri.",
    .preparing_pictures = "Preparazione immagini\xE2\x80\xA6",
    .preparing_book = "Preparazione del libro\xE2\x80\xA6",
    .preparing_book_once = "Solo la prima volta che viene aperto.",
    .preparing_book_stop = "Tocca lo schermo per interrompere.",
    .picture_broken = "Impossibile mostrarla",
    .pictures_shuffle_lead = "Ogni volta una nuova, tra quelle segnate.",
    .pictures_one_lead = "L’immagine segnata appare ogni volta.",
    .hint_pictures_shuffle = "Laterali: sposta · Accensione: segna · Home: indietro",
    .hint_pictures_one = "Laterali: sposta · Accensione: scegli · Home: indietro",
    .hint_preview = "Premi un tasto qualsiasi per tornare",
    .now_reading = "IN LETTURA",
    .last_7_days = "ULTIMI 7 GIORNI",
    .finished_label = "LETTI",
    .left_in_book = "Mancano %s",
    .library_view = "Vista Home e libreria",
    .view_names = {"Elenco", "Copertine"},
    .recent_label = "LETTI DI RECENTE",
    .move_finished = "Sposta libri letti",
    .move_names = {"No", "In Read/"},
    .folders = "Cartelle",
    .card_root = "Scheda di memoria",
    .folder_up = "Su di una cartella",
    .folder_empty = "Nessun libro o immagine in questa cartella.",
    .picture_failed = "Impossibile mostrare questa immagine.",
    .hint_picture = "Laterali: immagine successiva · Home: indietro",
    .night_mode = "Modalità notte",
    .focus_reading = "Lettura focalizzata",
    .book_styles = "Stili dell’editore",
    .paragraph_indent = "Rientro paragrafo",
    .indent_names = {"Come nel libro", "Sempre", "Mai"},
    .go_to = "Vai a…",
    .go = "Vai",
    .hint_go_coarse = "Laterali: ±10% · Accensione: più fine · Home: annulla",
    .hint_go_fine = "Laterali: ±1% · Accensione: vai · Home: annulla",
    .links_on_page = "Link in questa pagina",
    .hint_pick_link = "Laterali: scegli un link · Accensione: apri",
    .back_to_page = "Torna dov’eri",
    .note = "Nota",
    .finished_question = "Hai finito il libro?",
    .mark_read = "Segna come letto",
    .not_yet = "Non ancora",
    .setup_again = "Ripeti configurazione",
    .setup_step = "Passo %d di %d",
    .welcome = "Benvenuto",
    .welcome_lead = "Configuriamo alcune cose. Potrai cambiarle in Impostazioni. Prima di tutto, la lingua:",
    .clock_lead = "Come vuoi vedere l’ora in alto sullo schermo?",
    .menu_text_lead = "Quale dimensione del testo dei menu leggi meglio? Potrai cambiarla in Impostazioni.",
    .wifi_lead =
        "Con il Wi-Fi di casa il lettore può aggiornarsi e scaricare libri. Si imposta dal telefono, che "
        "regola anche l’orologio.",
    .set_up_now = "Configura ora",
    .books_lead =
        "I libri arrivano dal telefono o dal computer via Wi-Fi. Apri Aggiungi libri e segui i passi sullo "
        "schermo. Lo trovi sempre nella schermata Home.",
    .open_add_books = "Apri Aggiungi libri",
    .skip = "Salta",
    .next = "Avanti",
    .hint_welcome = "Laterali: sposta · Accensione: scegli · Home: indietro",
    .hint_welcome_first = "Laterali: sposta · Accensione: scegli",
    .page_settings = "Pagina",
    .display_light = "Schermo e luce",
    .sleep_battery = "Stop e batteria",
    .general = "Generali",
    .light_short = "Luce",
    .night_short = "Notte",
    .home_short = "Home",
    .sleep_short = "Stop",
    .hint_quick = "Laterali: sposta · Accensione: scegli · Home: chiudi",
    .starting_back = "Hai cambiato idea? Tocca Indietro o premi Home.",
    .back_label = "Indietro",
    .add_books_over = "Aggiungi libri via",
    .network_names = {"Wi-Fi di casa", "Rete propria"},
    .status_name = "Vellum",
    .delete_book = "Elimina libro",
    .delete_question = "Eliminare questo libro?",
    .delete_note =
        "Il libro viene tolto dalla scheda di memoria, con il punto di lettura, i segnalibri e le evidenziazioni. Non si può annullare.",
    .delete_yes = "Sì, elimina",
    .delete_no = "No, tienilo",
    .delete_failed = "Impossibile eliminare il libro",
    .book_locked = "Questo libro è bloccato",
    .book_no_text = "Solo immagini delle pagine, niente testo",
    .book_unreadable = "Impossibile leggere il libro",
