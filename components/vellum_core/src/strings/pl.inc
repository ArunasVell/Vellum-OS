    .language_name = "Polski",
    .continue_reading = "CZYTAJ DALEJ",
    .start_reading = "ZACZNIJ CZYTAĆ",
    .library_label = "BIBLIOTEKA",
    .library = "Biblioteka",
    .all_books = "Wszystkie książki",
    .settings = "Ustawienia",
    .not_started = "Nierozpoczęta",
    .page_of = "Strona %d z %d",
    .short_of = "%d z %d",
    .status_new = "Nowa",
    .status_finished = "Przeczytana",
    .hint_home = "Boczne: wybór · Zasilanie: otwórz",
    .hint_list = "Boczne: wybór · Zasilanie: otwórz · Start: wstecz",
    .hint_settings = "Boczne: wybór · Zasilanie: zmień · Start: wstecz",
    .reading = "Czytanie",
    .menu_font = "Czcionka menu",
    .menu_text = "Tekst menu",
    .menu_text_names = {"Normalny", "Duży"},
    .book_font = "Czcionka książki",
    .preview_label = "PODGLĄD",
    .language = "Język",
    .clock = "Zegar",
    .clock_24 = "24-godzinny",
    .clock_12 = "12-godzinny",
    .sleep_after = "Uśpij po",
    .sleep_names = {"5 min", "10 min", "30 min", "Nigdy"},
    .sleeping = "UŚPIONY",
    .wake_hint = "Naciśnij Zasilanie, aby wybudzić",
    .battery_empty = "Bateria rozładowana",
    .charge_hint = "Naładuj i naciśnij Zasilanie",
    .text_size = "Rozmiar tekstu",
    .size_names = {"Mały", "Średni", "Duży", "Bardzo duży"},
    .line_spacing = "Interlinia",
    .word_spacing = "Odstęp między słowami",
    .spacing_names = {"Wąski", "Normalny", "Szeroki"},
    .margins = "Marginesy",
    .margin_names = {"Wąskie", "Normalne", "Szerokie"},
    .alignment = "Wyrównanie",
    .justified = "Wyjustowane",
    .left = "Do lewej",
    .hyphenation = "Dzielenie wyrazów",
    .on = "Wł.",
    .off = "Wył.",
    .add_books = "Dodaj książki",
    .transfer_lead = "Wyślij książki EPUB, FB2 lub TXT z telefonu lub PC.",
    .step_join = "1  POŁĄCZ Z TYM WI-FI",
    .network = "Sieć",
    .password = "Hasło",
    .step_open = "2  OTWÓRZ W PRZEGLĄDARCE",
    .scan_hint = "Albo zeskanuj kody aparatem telefonu.",
    .received_label = "ODEBRANE",
    .waiting = "Czekam na książki…",
    .receiving = "Odbieram %s",
    .card_full = "Karta jest pełna.",
    .starting = "Włączam Wi-Fi…",
    .no_wifi = "Nie udało się włączyć Wi-Fi. Wróć i spróbuj ponownie.",
    .no_card = "Włóż kartę SD, aby dodać książki.",
    .hint_transfer = "Start: gotowe",
    .updating = "Aktualizuję Vellum · %d%%",
    .update_done = "Zainstalowano. Uruchamiam ponownie…",
    .update_not_vellum = "Ten plik nie jest aktualizacją Vellum.",
    .update_broken = "Aktualizacja przerwana. Nic nie zmieniono.",
    .contents = "Spis treści",
    .back_to_book = "Wróć do strony",
    .to_home_screen = "Ekran startowy",
    .add_bookmark = "Dodaj zakładkę",
    .remove_bookmark = "Usuń zakładkę",
    .bookmarks_label = "ZAKŁADKI",
    .chapters_label = "ROZDZIAŁY",
    .chapter_n = "Rozdział %d",
    .battery = "Bateria",
    .on_battery = "Na baterii",
    .charging = "Ładowanie",
    .history_label = "OSTATNIE 7 DNI",
    .estimates_label = "SZACUNKI",
    .time_left = "Pozostały czas",
    .while_reading = "Podczas czytania",
    .while_asleep = "W uśpieniu",
    .measuring = "Trwa pomiar",
    .per_hour = "%s%% na godzinę",
    .per_day = "%s%% dziennie",
    .clock_unset =
        "Zegar nie jest ustawiony, więc nie ma jeszcze historii. Otwórz Dodaj książki i raz wczytaj stronę w "
        "telefonie: to ustawi zegar.",
    .hint_battery = "Zasilanie lub Start: wstecz",
    .front_light = "Podświetlenie",
    .brightness = "Jasność",
    .warmth = "Ciepło barwy",
    .cool = "Zimne",
    .warm = "Ciepłe",
    .done = "Gotowe",
    .hint_light = "Boczne: zmień · Zasilanie: dalej",
    .device_check = "Test urządzenia",
    .buttons_label = "PRZYCISKI",
    .key_names = {"W górę", "W dół", "Start", "Zasilanie"},
    .touch_label = "DOTYK",
    .touch_here = "Dotknij ekranu w dowolnym miejscu",
    .about_label = "TO URZĄDZENIE",
    .device = "Model",
    .screen = "Ekran",
    .memory_card = "Karta pamięci",
    .wifi = "Wi-Fi",
    .free_memory = "Wolna pamięć",
    .version = "Wersja",
    .present = "Tak",
    .missing = "Brak",
    .not_set = "Nieustawione",
    .hint_check = "Naciśnij każdy przycisk · Oba boki: wstecz",
    .updates = "Aktualizacje",
    .this_version = "Vellum %s na tym czytniku",
    .status_label = "STAN",
    .up_to_date = "Vellum jest aktualny.",
    .update_ready = "Vellum %s czeka na instalację.",
    .not_checked = "Jeszcze nie sprawdzono.",
    .checked_at = "Sprawdzono: %s",
    .checking = "Szukam nowej wersji…",
    .installing = "Instaluję Vellum %s · %d%%",
    .need_home_wifi = "Ustaw domowe Wi-Fi, aby szukać aktualizacji.",
    .wifi_failed = "Nie udało się połączyć z domowym Wi-Fi.",
    .server_failed = "Brak połączenia z serwerem aktualizacji.",
    .install_failed = "Aktualizacja się nie zainstalowała. Nic nie zmieniono.",
    .check_now = "Sprawdź teraz",
    .install_version = "Zainstaluj Vellum %s",
    .automatic = "Automatycznie",
    .auto_names = {"W nocy", "Najpierw zapytaj", "Wył."},
    .auto_help = {"O 3:00, gdy czytnik śpi, szuka nowej wersji i ją instaluje.",
                  "O 3:00 szuka nowej wersji i informuje tutaj. Ty decydujesz, kiedy ją zainstalować.",
                  "Czytnik sam nie szuka nowych wersji."},
    .night_needs = "Wymaga domowego Wi-Fi i zegara, ustawianych z telefonu (Domowe Wi-Fi poniżej).",
    .home_wifi = "Domowe Wi-Fi",
    .from_file = "Aktualizuj z pliku",
    .hint_updates = "Zasilanie: wybierz · Start: wstecz",
    .setup_lead = "Ustaw domowe Wi-Fi lub wyślij plik aktualizacji.",
    .phone_label = "Z TELEFONU",
    .waiting_phone = "Czekam na telefon…",
    .wifi_saved = "Zapisano domowe Wi-Fi: %s",
    .hint_setup = "Start: wstecz",
    .update_notice = "Nowy Vellum %s",
    .update_new = "Nowa",
    .send_book = "Wyślij na inny Vellum",
    .send_title = "Wyślij książkę",
    .nearby_label = "CZYTNIKI W POBLIŻU",
    .looking = "Szukam czytników w pobliżu… Na drugim Vellum otwórz Dodaj książki.",
    .sending_to = "Wysyłam do: %s",
    .sent_to = "Wysłano do: %s. Książka jest już w jego bibliotece.",
    .send_no_answer = "Brak odpowiedzi. Trzymaj czytniki blisko, z Dodaj książki otwartym na drugim.",
    .send_refused = "Drugi czytnik odbiera teraz inną książkę.",
    .send_card_full = "Karta pamięci drugiego czytnika jest pełna.",
    .send_corrupt = "Książka dotarła uszkodzona. Spróbuj ponownie.",
    .send_unreadable = "Nie udało się odczytać tej książki z karty.",
    .hint_send = "Boczne: wybór · Zasilanie: wyślij · Start: wstecz",
    .hint_sending = "Start: anuluj",
    .hint_sent = "Zasilanie: wróć do książki",
    .hint_retry = "Zasilanie: ponów · Start: wstecz",
    .peer_hint = "Inny Vellum w pobliżu też może tu wysyłać książki: w książce otwórz Spis treści › Wyślij na inny Vellum.",
    .store_link = "Darmowe książki",
    .store_search_for = "Szukaj darmowych książek: \xE2\x80\x9E%s\xE2\x80\x9D",
    .store_title = "Darmowe książki",
    .store_lead = "Klasyka za darmo, przez domowe Wi-Fi",
    .store_demo = "Katalog demo: symulator nie ma internetu",
    .store_abouts = {"Ponad 70 000 klasyków w wielu językach", "Starannie wydana klasyka"},
    .store_lists = {"Najpopularniejsze", "Nowo dodane", "Po litewsku", "Przygoda", "Kryminały", "Fantastyka naukowa",
                    "Dla dzieci", "Poezja", "Nowości"},
    .store_loading = "Wczytuję…",
    .store_earlier = "Wcześniejsze książki",
    .store_more = "Więcej książek",
    .store_empty = "Brak książek.",
    .store_no_epub = "Ta książka nie ma pliku EPUB do pobrania.",
    .store_download = "Pobierz",
    .store_downloading = "Pobieram… %d%%",
    .store_saved = "Zapisano w bibliotece.",
    .store_read_now = "Czytaj teraz",
    .store_back = "Wróć do listy",
    .store_retry = "Spróbuj ponownie",
    .store_no_home_wifi = "Brak domowego Wi-Fi. Ustaw je w Ustawienia › Aktualizacje › Domowe Wi-Fi.",
    .store_no_server = "Brak połączenia z katalogiem. Spróbuj później.",
    .store_broke_off = "Pobieranie przerwane. Spróbuj ponownie.",
    .store_not_book = "Strona przesłała coś, co nie jest książką.",
    .hint_store_busy = "Proszę czekać…",
    .step_home = "1  W DOMOWYM WI-FI",
    .home_hint = "Połącz z nim też telefon lub komputer.",
    .scan_one_hint = "Albo zeskanuj kod aparatem telefonu.",
    .use_own_network = "Użyj własnej sieci czytnika",
    .use_home_wifi = "Użyj domowego Wi-Fi: %s",
    .home_wifi_failed = "Nie udało się połączyć z domowym Wi-Fi, więc czytnik otworzył własną sieć.",
    .sync_progress = "Synchronizuj postęp",
    .sync_busy = "Synchronizuję…",
    .sync_sent = "Wysłano %d%%",
    .sync_moved = "Przeniesiono do %d%%",
    .sync_up_to_date = "Aktualne",
    .sync_errors = {"Brak domowego Wi-Fi", "Błąd Wi-Fi", "Brak serwera", "Złe logowanie", "Nazwa zajęta"},
    .look_up_word = "Sprawdź słowo",
    .highlights_label = "ZAZNACZENIA",
    .highlight = "Zaznacz",
    .remove_highlight = "Usuń zaznaczenie",
    .close = "Zamknij",
    .save = "Zapisz",
    .cancel = "Anuluj",
    .no_dictionary =
        "Brak słownika. Umieść pliki StarDict w folderze dictionaries na karcie albo wyślij je przez Dodaj "
        "książki.",
    .not_in_dictionary = "Brak w słowniku.",
    .preparing_dictionary = "Przygotowuję słownik…",
    .hint_pick_line = "Boczne: wiersz · Zasilanie: wybierz · Start: wstecz",
    .hint_pick_word = "Boczne: słowo · Zasilanie: sprawdź · Start: wstecz",
    .hint_extend = "Stuknij ostatnie słowo lub przejdź do niego przyciskami bocznymi.",
    .footer = "Stopka",
    .footer_names = {"Numer strony", "Czas do końca rozdziału", "Procent przeczytany"},
    .footer_left = "%s do końca rozdziału",
    .contents_left = "Ok. %s do końca rozdziału · %s do końca książki",
    .reading_stats = "Statystyki czytania",
    .today_label = "DZIŚ",
    .week_label = "OSTATNIE 7 DNI · MINUTY",
    .weekdays = {"Pn", "Wt", "Śr", "Cz", "Pt", "So", "Nd"},
    .this_month = "Ten miesiąc",
    .reading_speed = "Tempo czytania",
    .pages_an_hour = "Stron na godzinę: %d",
    .all_time = "Od początku",
    .books_label = "KSIĄŻKI",
    .nothing_read = "Nic jeszcze nie przeczytano. Czas czytania pojawi się tu, gdy zaczniesz przewracać strony.",
    .stats_clock =
        "Zegar nie jest ustawiony, więc czytanie nie jest liczone w dniach. Otwórz Dodaj książki i raz wczytaj "
        "stronę w telefonie: to ustawi zegar.",
    .preview_text =
        "Wieczór był cichy, a rzeka powoli niosła ostatnie odblaski słońca obok starych wierzb, podczas gdy "
        "gdzieś za łąką pies zaszczekał dwa razy, a potem ucichł.",
    .preview_language = "pl",
    .sort_by = "Sortuj: %s",
    .sort_names = {"Ostatnie", "Tytuł", "Autor", "Dodane"},
    .search = "Szukaj",
    .search_prompt = "Tytuł lub autor",
    .ok = "OK",
    .tab_all = "Wszystkie",
    .tab_reading = "Czytane",
    .tab_finished = "Przeczytane",
    .new_shelf = "Nowa półka",
    .shelf_name = "Nazwa półki",
    .rename = "Zmień nazwę",
    .delete_shelf = "Usuń półkę",
    .delete_again = "Naciśnij ponownie, aby usunąć",
    .shelf_empty = "Na tej półce nie ma jeszcze książek. Przytrzymaj książkę we Wszystkich lub użyj Dodaj do półki w spisie treści.",
    .nothing_found = "Brak książek dla \xE2\x80\x9E%s\xE2\x80\x9D.",
    .no_books_here = "Nie ma tu jeszcze książek.",
    .add_to_shelf = "Dodaj do półki",
    .shelves = "Półki",
    .shelves_label = "PÓŁKI",
    .finished_reading = "Przeczytane",
    .buttons = "Przyciski",
    .button_pages = {"Podczas czytania", "W menu"},
    .input_names = {"W tył", "Dalej", "Zasilanie", "Start", "Przytrzymaj W tył", "Przytrzymaj Dalej",
                    "Przytrzymaj Start"},
    .action_names = {"Nic",           "Poprzednia strona", "Następna strona", "Poprzedni rozdział",
                     "Następny rozdział", "Spis treści",   "Ekran startowy",  "Biblioteka",
                     "Dodaj zakładkę", "Światło wł./wył.", "Podświetlenie",   "Autoprzewijanie",
                     "Pełne odświeżenie", "Zrzut ekranu",  "Uśpij",           "W górę",
                     "W dół",         "Otwórz",            "Wstecz",          "Strona w górę",
                     "Strona w dół",  "Szybki panel"},
    .reset_default = "Przywróć domyślne",
    .power_hold_note = "Przytrzymanie Zasilania przez sekundę zawsze usypia.",
    .way_back_note =
        "Pomijane są wybory, po których nie da się wrócić do spisu treści ani ekranu startowego, otwierać, "
        "cofać ani poruszać się po menu.",
    .screen_names = {"Pionowo", "Do góry nogami", "Poziomo, przyciski z lewej", "Poziomo, przyciski z prawej"},
    .auto_turn = "Autoprzewijanie",
    .every_seconds = "Co %d s",
    .full_refresh = "Pełne odświeżenie",
    .refresh_names = {"Co stronę", "Co 5 stron", "Co 12 stron", "Co 20 stron", "Nowy rozdział"},
    .start_auto_turn = "Przewracaj co %d s",
    .auto_turn_on = "Strony co %d s",
    .auto_turn_off = "Autoprzewijanie zatrzymane",
    .screenshot_saved = "Zapisano %s",
    .screenshot_failed = "Brak zrzutu: brak karty?",
    .sleep_screen = "Ekran uśpienia",
    .sleep_kinds = {"Okładka książki", "Moje obrazy", "Statystyki czytania", "Minimalny", "Ostatnia strona"},
    .sleep_help = {"Okładka czytanej książki.", "Twoje obrazy z folderu sleep.",
                   "Twoje postępy i czas czytania.", "Tytuł książki na spokojnej stronie.",
                   "Ostatni ekran zostaje, z oznaczeniem uśpienia."},
    .pictures_label = "MOJE OBRAZY",
    .sleep_order = "Obrazy",
    .sleep_order_names = {"Losowo", "Jeden obraz"},
    .choose_pictures = "Wybierz obrazy",
    .preview = "Podgląd",
    .no_pictures =
        "Brak obrazów. Umieść pliki JPG, PNG lub BMP w folderze sleep na karcie albo wyślij je "
        "ze strony w telefonie w Dodaj książki.",
    .preparing_pictures = "Przygotowuję obrazy\xE2\x80\xA6",
    .preparing_book = "Przygotowuję książkę\xE2\x80\xA6",
    .preparing_book_once = "Tylko przy pierwszym dodaniu.",
    .picture_broken = "Nie można wyświetlić",
    .pictures_shuffle_lead = "Za każdym razem inny, spośród zaznaczonych.",
    .pictures_one_lead = "Zawsze pokazuje się zaznaczony obraz.",
    .hint_pictures_shuffle = "Boczne: wybór · Zasilanie: zaznacz · Start: wstecz",
    .hint_pictures_one = "Boczne: wybór · Zasilanie: wybierz · Start: wstecz",
    .hint_preview = "Naciśnij dowolny przycisk, aby wrócić",
    .now_reading = "TERAZ CZYTASZ",
    .last_7_days = "OSTATNIE 7 DNI",
    .finished_label = "PRZECZYTANE",
    .left_in_book = "Zostało %s",
    .library_view = "Widok startu i biblioteki",
    .view_names = {"Lista", "Okładki"},
    .recent_label = "OSTATNIO CZYTANE",
    .move_finished = "Przenoś przeczytane",
    .move_names = {"Wył.", "Do Read/"},
    .folders = "Foldery",
    .card_root = "Karta pamięci",
    .folder_up = "Folder wyżej",
    .folder_empty = "Brak książek i obrazów w tym folderze.",
    .picture_failed = "Nie można wyświetlić tego obrazu.",
    .hint_picture = "Boczne: następny obraz · Start: wstecz",
    .night_mode = "Tryb nocny",
    .focus_reading = "Czytanie z fokusem",
    .book_styles = "Style wydawcy",
    .paragraph_indent = "Wcięcie akapitu",
    .indent_names = {"Jak w książce", "Zawsze", "Nigdy"},
    .go_to = "Przejdź do…",
    .go = "Idź",
    .hint_go_coarse = "Boczne ±10% · Zasilanie: dokładniej · Start: anuluj",
    .hint_go_fine = "Boczne ±1% · Zasilanie: idź · Start: anuluj",
    .links_on_page = "Linki na tej stronie",
    .hint_pick_link = "Boczne: wybierz link · Zasilanie: otwórz",
    .back_to_page = "Wróć do poprzedniego miejsca",
    .note = "Przypis",
    .finished_question = "Skończona książka?",
    .mark_read = "Oznacz jako przeczytaną",
    .not_yet = "Jeszcze nie",
    .setup_again = "Konfiguruj ponownie",
    .setup_step = "Krok %d z %d",
    .welcome = "Witaj",
    .welcome_lead = "Ustawmy kilka rzeczy. Możesz je później zmienić w Ustawieniach. Najpierw język:",
    .clock_lead = "Jak ma wyglądać godzina u góry ekranu?",
    .menu_text_lead = "Który rozmiar tekstu menu czyta się łatwiej? Możesz go później zmienić w Ustawieniach.",
    .wifi_lead =
        "Z domowym Wi-Fi czytnik może się sam aktualizować i pobierać książki z domu. Ustawisz je "
        "telefonem, który ustawi też zegar.",
    .set_up_now = "Ustaw teraz",
    .books_lead =
        "Książki trafiają z telefonu lub komputera przez Wi-Fi. Otwórz Dodaj książki i postępuj zgodnie z "
        "instrukcjami na ekranie. Znajdziesz to zawsze na ekranie startowym.",
    .open_add_books = "Otwórz Dodaj książki",
    .skip = "Pomiń",
    .next = "Dalej",
    .hint_welcome = "Boczne: wybór · Zasilanie: wybierz · Start: wstecz",
    .hint_welcome_first = "Boczne: wybór · Zasilanie: wybierz",
    .page_settings = "Strona",
    .display_light = "Ekran i światło",
    .sleep_battery = "Uśpienie i bateria",
    .general = "Ogólne",
    .light_short = "Światło",
    .night_short = "Noc",
    .home_short = "Start",
    .sleep_short = "Uśpij",
    .hint_quick = "Boczne: wybór · Zasilanie: wybierz · Start: zamknij",
    .starting_back = "Zmiana planów? Stuknij Wstecz lub naciśnij Start.",
    .back_label = "Wstecz",
    .add_books_over = "Dodawaj książki przez",
    .network_names = {"Domowe Wi-Fi", "Własna sieć"},
    .status_name = "Vellum",
