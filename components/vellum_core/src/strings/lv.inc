    .language_name = "Latviešu",
    .continue_reading = "TURPINĀT LASĪT",
    .start_reading = "SĀKT LASĪT",
    .library_label = "BIBLIOTĒKA",
    .library = "Bibliotēka",
    .all_books = "Visas grāmatas",
    .settings = "Iestatījumi",
    .not_started = "Nav sākta",
    .page_of = "Lappuse %d no %d",
    .short_of = "%d no %d",
    .status_new = "Jauna",
    .status_finished = "Izlasīta",
    .hint_home = "Sānu pogas: pārvietot · Barošana: atvērt",
    .hint_list = "Sānu pogas: pārvietot · Barošana: atvērt · Sākums: atpakaļ",
    .hint_settings = "Sānu pogas: pārvietot · Barošana: mainīt · Sākums: atpakaļ",
    .reading = "Lasīšana",
    .menu_font = "Izvēlnes fonts",
    .menu_text = "Izvēlnes teksts",
    .menu_text_names = {"Parasts", "Liels"},
    .book_font = "Grāmatas fonts",
    .preview_label = "PRIEKŠSKATĪJUMS",
    .language = "Valoda",
    .clock = "Pulkstenis",
    .clock_24 = "24 stundu",
    .clock_12 = "12 stundu",
    .time_zone = "Laika josla",
    .zone_auto = "autom.",
    .sleep_after = "Iemigt pēc",
    .sleep_names = {"5 min", "10 min", "30 min", "Nekad"},
    .sleeping = "MIEGA REŽĪMĀ",
    .wake_hint = "Nospiediet barošanas pogu",
    .battery_empty = "Akumulators tukšs",
    .charge_hint = "Uzlādējiet un nospiediet barošanas pogu",
    .text_size = "Teksta lielums",
    .size_names = {"Mazs", "Vidējs", "Liels", "Ļoti liels"},
    .line_spacing = "Rindstarpas",
    .word_spacing = "Vārdu atstarpes",
    .spacing_names = {"Šauras", "Parastas", "Platas"},
    .margins = "Malas",
    .margin_names = {"Šauras", "Parastas", "Platas"},
    .alignment = "Līdzinājums",
    .justified = "Abās malās",
    .left = "Pa kreisi",
    .hyphenation = "Vārdu pārnešana",
    .on = "Ieslēgts",
    .off = "Izslēgts",
    .add_books = "Pievienot grāmatas",
    .transfer_lead = "Sūtiet EPUB, FB2 vai TXT grāmatas no tālruņa vai datora.",
    .step_join = "1  PIEVIENOJIETIES ŠIM WI-FI",
    .network = "Tīkls",
    .password = "Parole",
    .step_open = "2  ATVERIET PĀRLŪKĀ",
    .scan_hint = "Vai skenējiet kodus ar tālruņa kameru.",
    .received_label = "SAŅEMTS",
    .waiting = "Gaida grāmatas…",
    .receiving = "Saņem: %s",
    .card_full = "Karte ir pilna.",
    .starting = "Ieslēdz Wi-Fi…",
    .no_wifi = "Neizdevās ieslēgt Wi-Fi. Atgriezieties un mēģiniet vēlreiz.",
    .no_card = "Ievietojiet SD karti, lai pievienotu grāmatas.",
    .hint_transfer = "Sākums: gatavs",
    .updating = "Atjaunina Vellum · %d%%",
    .update_done = "Atjauninājums instalēts. Restartē…",
    .update_not_vellum = "Šis fails nav Vellum atjauninājums.",
    .update_broken = "Atjaunināšana pārtrūka. Nekas netika mainīts.",
    .contents = "Saturs",
    .back_to_book = "Atpakaļ uz lappusi",
    .to_home_screen = "Sākuma ekrāns",
    .add_bookmark = "Atzīmēt šo lappusi",
    .remove_bookmark = "Noņemt šo grāmatzīmi",
    .bookmarks_label = "GRĀMATZĪMES",
    .chapters_label = "NODAĻAS",
    .chapter_n = "%d. nodaļa",
    .battery = "Akumulators",
    .on_battery = "No akumulatora",
    .page_turn_ms = "lappuse %u ms",
    .charging = "Lādējas",
    .history_label = "PĒDĒJĀS 7 DIENAS",
    .estimates_label = "APLĒSES",
    .time_left = "Atlikušais laiks",
    .while_reading = "Lasot",
    .while_asleep = "Miega režīmā",
    .measuring = "Vēl mēra",
    .per_hour = "%s %% stundā",
    .per_day = "%s %% dienā",
    .clock_unset =
        "Pulkstenis nav iestatīts, tāpēc vēstures vēl nav. Atveriet „Pievienot grāmatas” un vienreiz ielādējiet "
        "lapu tālrunī: tā iestatīs pulksteni.",
    .hint_battery = "Barošana vai Sākums: atpakaļ",
    .front_light = "Apgaismojums",
    .brightness = "Spilgtums",
    .warmth = "Siltums",
    .cool = "Vēss",
    .warm = "Silts",
    .done = "Gatavs",
    .hint_light = "Sānu pogas: mainīt · Barošana: tālāk",
    .device_check = "Ierīces pārbaude",
    .buttons_label = "POGAS",
    .key_names = {"Augšup", "Lejup", "Sākums", "Barošana"},
    .touch_label = "SKĀRIENS",
    .touch_here = "Pieskarieties jebkur ekrānā",
    .about_label = "ŠĪ IERĪCE",
    .device = "Modelis",
    .screen = "Ekrāns",
    .memory_card = "Atmiņas karte",
    .wifi = "Wi-Fi",
    .free_memory = "Brīvā atmiņa",
    .version = "Versija",
    .present = "Ir",
    .missing = "Nav",
    .not_set = "Nav iestatīts",
    .hint_check = "Nospiediet katru pogu · Abas puses: atpakaļ",
    .updates = "Atjauninājumi",
    .this_version = "Šajā ierīcē: Vellum %s",
    .status_label = "STATUSS",
    .up_to_date = "Vellum ir jaunākā versija.",
    .update_ready = "Vellum %s ir gatavs instalēšanai.",
    .not_checked = "Vēl nav pārbaudīts.",
    .checked_at = "Pēdējoreiz pārbaudīts %s",
    .checking = "Meklē jaunu versiju…",
    .installing = "Instalē Vellum %s · %d%%",
    .need_home_wifi = "Iestatiet mājas Wi-Fi, lai meklētu atjauninājumus.",
    .wifi_failed = "Neizdevās pievienoties mājas Wi-Fi.",
    .server_failed = "Neizdevās sasniegt atjauninājumu serveri.",
    .install_failed = "Atjauninājums netika instalēts. Nekas netika mainīts.",
    .check_now = "Pārbaudīt tagad",
    .install_version = "Instalēt Vellum %s",
    .automatic = "Automātiski",
    .auto_names = {"Naktī", "Vispirms jautāt", "Izslēgts"},
    .auto_help = {"Plkst. 3:00, kamēr ierīce guļ, tā meklē jaunu versiju un to instalē.",
                  "Plkst. 3:00 tā meklē jaunu versiju un paziņo šeit. Kad instalēt, izvēlaties jūs.",
                  "Ierīce pati jaunas versijas nemeklē."},
    .night_needs = "Tam vajag mājas Wi-Fi un pulksteni, abus iestata tālrunī (Mājas Wi-Fi zemāk).",
    .home_wifi = "Mājas Wi-Fi",
    .from_file = "Atjaunināt no faila",
    .hint_updates = "Barošana: izvēlēties · Sākums: atpakaļ",
    .setup_lead = "Iestatiet mājas Wi-Fi vai nosūtiet atjauninājumu.",
    .phone_label = "NO TĀLRUŅA",
    .waiting_phone = "Gaida tālruni…",
    .wifi_saved = "Mājas Wi-Fi saglabāts: %s",
    .hint_setup = "Sākums: atpakaļ",
    .update_notice = "Jauns Vellum %s",
    .update_new = "Jauns",
    .whats_new = "Kas jauns",
    .note_groups = {"JAUNAS IESPĒJAS", "KĻŪDU LABOJUMI", "CITAS IZMAIŅAS"},
    .hint_notes = "Sānu pogas: lapas · Barošana: instalēt · Sākums: atpakaļ",
    .hint_notes_done = "Sānu pogas: lapas · Barošana/Sākums: aizvērt",
    .send_book = "Sūtīt uz citu Vellum",
    .send_title = "Sūtīt grāmatu",
    .nearby_label = "IERĪCES TUVUMĀ",
    .looking = "Meklē ierīces tuvumā… Otrā Vellum atveriet „Pievienot grāmatas”.",
    .sending_to = "Sūta uz %s",
    .sent_to = "Nosūtīts uz %s. Grāmata tagad ir tās bibliotēkā.",
    .send_no_answer = "Nav atbildes. Turiet abas ierīces tuvu, otrā atveriet „Pievienot grāmatas”.",
    .send_refused = "Otra ierīce pašlaik saņem citu grāmatu.",
    .send_card_full = "Otras ierīces atmiņas karte ir pilna.",
    .send_corrupt = "Grāmata pienāca bojāta. Mēģiniet vēlreiz.",
    .send_unreadable = "Šo grāmatu neizdevās nolasīt no kartes.",
    .hint_send = "Sānu pogas: pārvietot · Barošana: sūtīt · Sākums: atpakaļ",
    .hint_sending = "Sākums: atcelt",
    .hint_sent = "Barošana: atpakaļ uz grāmatu",
    .hint_retry = "Barošana: mēģināt vēlreiz · Sākums: atpakaļ",
    .peer_hint = "Arī cits Vellum tuvumā var sūtīt šurp grāmatas: grāmatā atveriet Saturs › Sūtīt uz citu Vellum.",
    .store_link = "Iegūt bezmaksas grāmatas",
    .store_search_for = "Meklēt bezmaksas grāmatās: „%s”",
    .store_title = "Bezmaksas grāmatas",
    .store_lead = "Klasika bez maksas, caur mājas Wi-Fi",
    .store_demo = "Demo katalogs: simulatoram nav interneta",
    .store_abouts = {"Virs 70 000 klasikas darbu daudzās valodās", "Rūpīgi sagatavoti klasikas izdevumi"},
    .store_lists = {"Populārākās", "Nesen pievienotās", "Lietuviešu valodā", "Piedzīvojumi", "Detektīvi",
                    "Zinātniskā fantastika", "Bērniem", "Dzeja", "Jaunākie izdevumi"},
    .store_loading = "Ielādē…",
    .store_earlier = "Iepriekšējās grāmatas",
    .store_more = "Vairāk grāmatu",
    .store_empty = "Šeit nav grāmatu.",
    .store_no_epub = "Šai grāmatai nav EPUB lejupielādei.",
    .store_download = "Lejupielādēt",
    .store_downloading = "Lejupielādē… %d%%",
    .store_saved = "Saglabāta jūsu bibliotēkā.",
    .store_read_now = "Lasīt tagad",
    .store_back = "Atpakaļ uz sarakstu",
    .store_retry = "Mēģināt vēlreiz",
    .store_no_home_wifi = "Mājas Wi-Fi nav iestatīts. Iestatiet to: Iestatījumi › Atjauninājumi › Mājas Wi-Fi.",
    .store_no_server = "Neizdevās sasniegt katalogu. Mēģiniet vēlāk.",
    .store_broke_off = "Lejupielāde pārtrūka. Mēģiniet vēlreiz.",
    .store_not_book = "Vietne atsūtīja kaut ko, kas nav grāmata.",
    .hint_store_busy = "Lūdzu, uzgaidiet…",
    .step_home = "1  JŪSU MĀJAS WI-FI",
    .home_hint = "Pievienojiet tam arī tālruni vai datoru.",
    .scan_one_hint = "Vai skenējiet kodu ar tālruņa kameru.",
    .use_own_network = "Lietot ierīces tīklu",
    .use_home_wifi = "Lietot mājas Wi-Fi: %s",
    .home_wifi_failed = "Neizdevās pievienoties mājas Wi-Fi, tāpēc ierīce atvēra savu tīklu.",
    .sync_progress = "Sinhronizēt progresu",
    .sync_busy = "Sinhronizē…",
    .sync_sent = "Nosūtīts %d%%",
    .sync_moved = "Pārcelts uz %d%%",
    .sync_up_to_date = "Jau sinhronizēts",
    .sync_errors = {"Nav mājas Wi-Fi", "Wi-Fi kļūda", "Nav servera", "Pieteikšanās kļūda", "Vārds aizņemts"},
    .look_up_word = "Meklēt vārdu",
    .highlights_label = "IZCĒLUMI",
    .highlight = "Izcelt",
    .remove_highlight = "Noņemt izcēlumu",
    .close = "Aizvērt",
    .save = "Saglabāt",
    .cancel = "Atcelt",
    .no_dictionary =
        "Vārdnīcas vēl nav. Ielieciet StarDict failus kartes mapē dictionaries vai nosūtiet tos caur "
        "„Pievienot grāmatas”.",
    .not_in_dictionary = "Vārdnīcā nav atrasts.",
    .preparing_dictionary = "Sagatavo vārdnīcu…",
    .hint_pick_line = "Sānu pogas: rinda · Barošana: izvēlēties · Sākums: atpakaļ",
    .hint_pick_word = "Sānu pogas: vārds · Barošana: meklēt · Sākums: atpakaļ",
    .hint_extend = "Pieskarieties pēdējam vārdam vai aizejiet līdz tam ar sānu pogām.",
    .footer = "Kājene",
    .footer_names = {"Lappuses numurs", "Atlicis nodaļā", "Izlasītā daļa"},
    .footer_left = "Nodaļā vēl %s",
    .contents_left = "Nodaļā vēl ap %s · grāmatā %s",
    .reading_stats = "Lasīšanas statistika",
    .today_label = "ŠODIEN",
    .week_label = "PĒDĒJĀS 7 DIENAS · MINŪTES",
    .weekdays = {"Pr", "Ot", "Tr", "Ce", "Pk", "Se", "Sv"},
    .this_month = "Šomēnes",
    .reading_speed = "Lasīšanas ātrums",
    .pages_an_hour = "%d lpp. stundā",
    .all_time = "Kopā",
    .books_label = "GRĀMATAS",
    .nothing_read = "Vēl nekas nav lasīts. Lasīšanas laiks parādīsies šeit, kad šķirsiet lappuses.",
    .stats_clock =
        "Pulkstenis nav iestatīts, tāpēc lasīšana netiek skaitīta pa dienām. Atveriet „Pievienot grāmatas” "
        "un vienreiz ielādējiet lapu tālrunī: tā iestatīs pulksteni.",
    .preview_text =
        "Vakars bija kluss, un upe lēnām nesa pēdējos saules atspīdumus garām vecajiem vītoliem, "
        "kamēr kaut kur aiz pļavas divreiz ierējās suns un tad apklusa.",
    .preview_language = "lv",
    .sort_by = "Kārtot: %s",
    .sort_names = {"Nesenās", "Nosaukums", "Autors", "Pievienotās"},
    .search = "Meklēt",
    .search_prompt = "Nosaukums vai autors",
    .ok = "Labi",
    .tab_all = "Visas",
    .tab_reading = "Lasu tagad",
    .tab_finished = "Izlasītas",
    .new_shelf = "Jauns plaukts",
    .shelf_name = "Plaukta nosaukums",
    .rename = "Pārdēvēt",
    .delete_shelf = "Dzēst plauktu",
    .delete_again = "Nospiediet vēlreiz, lai dzēstu",
    .shelf_empty =
        "Šajā plauktā vēl nav grāmatu. Turiet grāmatu sadaļā Visas vai grāmatas saturā izvēlieties Pievienot "
        "plauktam.",
    .nothing_found = "Nav grāmatu, kas atbilst „%s”.",
    .no_books_here = "Šeit vēl nav grāmatu.",
    .add_to_shelf = "Pievienot plauktam",
    .shelves = "Plaukti",
    .shelves_label = "PLAUKTI",
    .finished_reading = "Izlasīta",
    .buttons = "Pogas",
    .button_pages = {"Lasot", "Izvēlnēs"},
    .input_names = {"Atpakaļ", "Tālāk", "Barošana", "Sākums", "Turēt Atpakaļ", "Turēt Tālāk", "Turēt Sākums"},
    .action_names = {"Nekas",
                     "Iepriekšējā lpp.",
                     "Nākamā lpp.",
                     "Iepriekšējā nodaļa",
                     "Nākamā nodaļa",
                     "Saturs",
                     "Sākuma ekrāns",
                     "Bibliotēka",
                     "Grāmatzīme",
                     "Gaisma iesl./izsl.",
                     "Apgaismojums",
                     "Automātiska šķiršana",
                     "Pilna atsvaidzināšana",
                     "Ekrānuzņēmums",
                     "Miegs",
                     "Augšup",
                     "Lejup",
                     "Atvērt",
                     "Atpakaļ",
                     "Lpp. augšup",
                     "Lpp. lejup",
                     "Ātrais panelis"},
    .reset_default = "Atjaunot noklusējumu",
    .power_hold_note = "Turot barošanas pogu sekundi, ierīce vienmēr iemieg.",
    .way_back_note =
        "Izvēles, kas atstātu bez ceļa uz saturu vai sākumu vai bez iespējas izvēlnēs atvērt, "
        "atgriezties un pārvietoties, tiek izlaistas.",
    .screen_names = {"Vertikāli", "Otrādi", "Horizontāli, pogas pa kreisi", "Horizontāli, pogas pa labi"},
    .screen_note = "Grāmatas pagriežas horizontāli, kad tās atver. Izvēlnes paliek vertikāli.",
    .auto_turn = "Automātiska šķiršana",
    .every_seconds = "Ik pēc %d s",
    .full_refresh = "Pilna atsvaidzināšana",
    .refresh_names = {"Katru lappusi", "Ik pēc 5 lpp.", "Ik pēc 12 lpp.", "Ik pēc 20 lpp.", "Jauna nodaļa"},
    .start_auto_turn = "Šķirt lappuses ik pēc %d s",
    .auto_turn_on = "Lappuses šķiras ik pēc %d s",
    .auto_turn_off = "Automātiskā šķiršana apturēta",
    .screenshot_saved = "Saglabāts: %s",
    .screenshot_failed = "Nav ekrānuzņēmuma: nav kartes?",
    .sleep_screen = "Miega ekrāns",
    .sleep_kinds = {"Grāmatas vāks", "Mani attēli", "Lasīšanas statistika", "Minimāls", "Lappuse kā bija"},
    .sleep_help = {"Lasāmās grāmatas vāks.", "Jūsu attēli no mapes sleep.", "Jūsu progress un lasīšanas laiks.",
                   "Grāmatas nosaukums mierīgā lapā.", "Paliek pēdējais ekrāns ar miega atzīmi."},
    .pictures_label = "MANI ATTĒLI",
    .sleep_order = "Attēli",
    .sleep_order_names = {"Jaukt", "Viens attēls"},
    .choose_pictures = "Izvēlēties attēlus",
    .preview = "Priekšskatījums",
    .no_pictures =
        "Attēlu vēl nav. Ielieciet JPG, PNG vai BMP failus kartes mapē sleep vai nosūtiet tos "
        "no „Pievienot grāmatas” tālruņa lapas.",
    .preparing_pictures = "Sagatavo attēlus\xE2\x80\xA6",
    .preparing_book = "Sagatavo grāmatu\xE2\x80\xA6",
    .preparing_book_once = "Tikai pirmo reizi to atverot.",
    .preparing_book_stop = "Pieskarieties ekrānam, lai apturētu.",
    .picture_broken = "Nevar parādīt",
    .pictures_shuffle_lead = "Katru reizi cits, no atzīmētajiem.",
    .pictures_one_lead = "Atzīmētais attēls tiek rādīts katru reizi.",
    .hint_pictures_shuffle = "Sānu pogas: pārvietot · Barošana: atzīmēt · Sākums: atpakaļ",
    .hint_pictures_one = "Sānu pogas: pārvietot · Barošana: izvēlēties · Sākums: atpakaļ",
    .hint_preview = "Nospiediet jebkuru pogu, lai atgrieztos",
    .now_reading = "PAŠLAIK LASU",
    .last_7_days = "PĒDĒJĀS 7 DIENAS",
    .finished_label = "IZLASĪTAS",
    .left_in_book = "Vēl %s",
    .library_view = "Sākuma un bibliotēkas skats",
    .view_names = {"Saraksts", "Vāki"},
    .recent_label = "NESEN LASĪTAS",
    .move_finished = "Pārvietot izlasītās",
    .move_names = {"Izslēgts", "Uz Read/"},
    .folders = "Mapes",
    .card_root = "Atmiņas karte",
    .folder_up = "Vienu mapi augstāk",
    .folder_empty = "Šajā mapē nav grāmatu vai attēlu.",
    .picture_failed = "Šo attēlu nevar parādīt.",
    .hint_picture = "Sānu pogas: nākamais attēls · Sākums: atpakaļ",
    .night_mode = "Nakts režīms",
    .focus_reading = "Fokusēta lasīšana",
    .book_styles = "Izdevēja stili",
    .paragraph_indent = "Rindkopas atkāpe",
    .indent_names = {"Kā grāmatā", "Vienmēr", "Nekad"},
    .go_to = "Pāriet uz…",
    .go = "Iet",
    .hint_go_coarse = "Sānu pogas: ±10% · Barošana: precīzāk · Sākums: atcelt",
    .hint_go_fine = "Sānu pogas: ±1% · Barošana: iet · Sākums: atcelt",
    .links_on_page = "Saites šajā lappusē",
    .hint_pick_link = "Sānu pogas: izvēlēties saiti · Barošana: atvērt",
    .back_to_page = "Atpakaļ, kur bijāt",
    .note = "Piezīme",
    .finished_question = "Izlasījāt grāmatu?",
    .mark_read = "Atzīmēt kā izlasītu",
    .not_yet = "Vēl ne",
    .setup_again = "Iestatīt no jauna",
    .setup_step = "%d. solis no %d",
    .welcome = "Laipni lūdzam",
    .welcome_lead = "Iestatīsim dažas lietas. Vēlāk tās var mainīt Iestatījumos. Vispirms valoda:",
    .clock_lead = "Kā rādīt laiku ekrāna augšā?",
    .menu_text_lead = "Kāda izmēra izvēlnes tekstu ir vieglāk lasīt? Vēlāk to var mainīt Iestatījumos.",
    .wifi_lead =
        "Ar mājas Wi-Fi ierīce var pati atjaunināties un saņemt grāmatas no mājām. To iestata tālrunī, "
        "kopā ar pulksteni.",
    .set_up_now = "Iestatīt tagad",
    .books_lead =
        "Grāmatas nāk no tālruņa vai datora pa Wi-Fi. Atveriet „Pievienot grāmatas” un sekojiet norādēm "
        "ekrānā. Tas vienmēr atrodams sākuma ekrānā.",
    .open_add_books = "Atvērt „Pievienot grāmatas”",
    .skip = "Izlaist",
    .next = "Tālāk",
    .hint_welcome = "Sānu pogas: pārvietot · Barošana: izvēlēties · Sākums: atpakaļ",
    .hint_welcome_first = "Sānu pogas: pārvietot · Barošana: izvēlēties",
    .page_settings = "Lappuse",
    .display_light = "Ekrāns un gaisma",
    .sleep_battery = "Miegs un akumulators",
    .general = "Vispārīgi",
    .light_short = "Gaisma",
    .night_short = "Nakts",
    .home_short = "Sākums",
    .sleep_short = "Miegs",
    .hint_quick = "Sānu pogas: pārvietot · Barošana: izvēlēties · Sākums: aizvērt",
    .starting_back = "Pārdomājāt? Pieskarieties Atpakaļ vai nospiediet Sākums.",
    .back_label = "Atpakaļ",
    .add_books_over = "Pievienot grāmatas caur",
    .network_names = {"Mājas Wi-Fi", "Ierīces tīklu"},
    .status_name = "Vellum",
    .delete_book = "Dzēst grāmatu",
    .delete_question = "Dzēst šo grāmatu?",
    .delete_note =
        "Grāmata tiks izdzēsta no atmiņas kartes kopā ar lasīšanas vietu, grāmatzīmēm un iezīmējumiem. To nevar atsaukt.",
    .delete_yes = "Jā, dzēst",
    .delete_no = "Nē, paturēt",
    .delete_failed = "Grāmatu neizdevās izdzēst",
    .book_locked = "Šī grāmata ir bloķēta",
    .book_no_text = "Tikai lapu attēli, bez teksta",
    .book_unreadable = "Grāmatu neizdevās nolasīt",
