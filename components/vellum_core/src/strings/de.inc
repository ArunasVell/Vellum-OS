    .language_name = "Deutsch",
    .continue_reading = "WEITERLESEN",
    .start_reading = "LESEN BEGINNEN",
    .library_label = "BIBLIOTHEK",
    .library = "Bibliothek",
    .all_books = "Alle Bücher",
    .settings = "Einstellungen",
    .not_started = "Nicht begonnen",
    .page_of = "Seite %d von %d",
    .short_of = "%d von %d",
    .status_new = "Neu",
    .status_finished = "Gelesen",
    .hint_home = "Seitentasten: wählen · Power: öffnen",
    .hint_list = "Seitentasten: wählen · Power: öffnen · Home: zurück",
    .hint_settings = "Seitentasten: wählen · Power: ändern · Home: zurück",
    .reading = "Lesen",
    .menu_font = "Menüschrift",
    .menu_text = "Menütext",
    .menu_text_names = {"Normal", "Groß"},
    .book_font = "Buchschrift",
    .preview_label = "VORSCHAU",
    .language = "Sprache",
    .clock = "Uhr",
    .clock_24 = "24 Stunden",
    .clock_12 = "12 Stunden",
    .sleep_after = "Ruhemodus nach",
    .sleep_names = {"5 Min.", "10 Min.", "30 Min.", "Nie"},
    .sleeping = "RUHEMODUS",
    .wake_hint = "Zum Aufwecken Power drücken",
    .battery_empty = "Akku leer",
    .charge_hint = "Aufladen, dann Power drücken",
    .text_size = "Textgröße",
    .size_names = {"Klein", "Mittel", "Groß", "Sehr groß"},
    .line_spacing = "Zeilenabstand",
    .word_spacing = "Wortabstand",
    .spacing_names = {"Eng", "Normal", "Weit"},
    .margins = "Ränder",
    .margin_names = {"Schmal", "Normal", "Breit"},
    .alignment = "Ausrichtung",
    .justified = "Blocksatz",
    .left = "Links",
    .hyphenation = "Silbentrennung",
    .on = "Ein",
    .off = "Aus",
    .add_books = "Bücher hinzufügen",
    .transfer_lead = "EPUB-, FB2- oder TXT-Bücher vom Handy oder PC senden.",
    .step_join = "1  MIT DIESEM WI-FI VERBINDEN",
    .network = "Netzwerk",
    .password = "Passwort",
    .step_open = "2  IM BROWSER ÖFFNEN",
    .scan_hint = "Oder die Codes mit der Handykamera scannen.",
    .received_label = "EMPFANGEN",
    .waiting = "Warte auf Bücher…",
    .receiving = "Empfange %s",
    .card_full = "Die Karte ist voll.",
    .starting = "Wi-Fi startet…",
    .no_wifi = "Wi-Fi konnte nicht starten. Zurück und erneut versuchen.",
    .no_card = "SD-Karte einlegen, um Bücher hinzuzufügen.",
    .hint_transfer = "Home: fertig",
    .updating = "Vellum wird aktualisiert · %d%%",
    .update_done = "Update installiert. Neustart…",
    .update_not_vellum = "Diese Datei ist kein Vellum-Update.",
    .update_broken = "Update abgebrochen. Nichts wurde geändert.",
    .contents = "Inhalt",
    .back_to_book = "Zurück zur Seite",
    .to_home_screen = "Startbildschirm",
    .add_bookmark = "Lesezeichen setzen",
    .remove_bookmark = "Lesezeichen entfernen",
    .bookmarks_label = "LESEZEICHEN",
    .chapters_label = "KAPITEL",
    .chapter_n = "Kapitel %d",
    .battery = "Akku",
    .on_battery = "Akkubetrieb",
    .page_turn_ms = "Seite %u ms",
    .charging = "Wird geladen",
    .history_label = "LETZTE 7 TAGE",
    .estimates_label = "SCHÄTZUNG",
    .time_left = "Restzeit",
    .while_reading = "Beim Lesen",
    .while_asleep = "Im Ruhemodus",
    .measuring = "Wird noch gemessen",
    .per_hour = "%s%% pro Stunde",
    .per_day = "%s%% pro Tag",
    .clock_unset =
        "Die Uhr ist nicht gestellt, daher gibt es noch keinen Verlauf. Einmal »Bücher hinzufügen« öffnen und die "
        "Seite auf dem Handy laden: Das stellt die Uhr.",
    .hint_battery = "Power oder Home: zurück",
    .front_light = "Beleuchtung",
    .brightness = "Helligkeit",
    .warmth = "Farbwärme",
    .cool = "Kalt",
    .warm = "Warm",
    .done = "Fertig",
    .hint_light = "Seitentasten: ändern · Power: weiter",
    .device_check = "Gerätetest",
    .buttons_label = "TASTEN",
    .key_names = {"Hoch", "Runter", "Home", "Power"},
    .touch_label = "TOUCH",
    .touch_here = "Irgendwo auf den Bildschirm tippen",
    .about_label = "DIESES GERÄT",
    .device = "Modell",
    .screen = "Bildschirm",
    .memory_card = "Speicherkarte",
    .wifi = "Wi-Fi",
    .free_memory = "Freier Speicher",
    .version = "Version",
    .present = "Ja",
    .missing = "Fehlt",
    .not_set = "Nicht festgelegt",
    .hint_check = "Jede Taste drücken · Beide Seiten: zurück",
    .updates = "Updates",
    .this_version = "Vellum %s auf diesem Reader",
    .status_label = "STATUS",
    .up_to_date = "Vellum ist auf dem neuesten Stand.",
    .update_ready = "Vellum %s kann installiert werden.",
    .not_checked = "Noch nicht geprüft.",
    .checked_at = "Zuletzt geprüft: %s",
    .checking = "Suche nach neuer Version…",
    .installing = "Vellum %s wird installiert · %d%%",
    .need_home_wifi = "Wi-Fi zu Hause einrichten, um nach Updates zu suchen.",
    .wifi_failed = "Keine Verbindung zum Wi-Fi zu Hause.",
    .server_failed = "Update-Server nicht erreichbar.",
    .install_failed = "Das Update wurde nicht installiert. Nichts wurde geändert.",
    .check_now = "Jetzt prüfen",
    .install_version = "Vellum %s installieren",
    .automatic = "Automatisch",
    .auto_names = {"Nachts", "Erst fragen", "Aus"},
    .auto_help = {"Um 3:00 Uhr sucht der Reader im Ruhemodus nach einer neuen Version und installiert sie.",
                  "Um 3:00 Uhr sucht er nach einer neuen Version und meldet sie hier. Sie wählen, wann installiert "
                  "wird.",
                  "Der Reader sucht nicht selbst nach neuen Versionen."},
    .night_needs = "Dafür sind Wi-Fi zu Hause und die Uhr nötig, beide vom Handy aus eingestellt (Wi-Fi zu Hause unten).",
    .home_wifi = "Wi-Fi zu Hause",
    .from_file = "Update aus Datei",
    .hint_updates = "Power: wählen · Home: zurück",
    .setup_lead = "Wi-Fi zu Hause einrichten oder Update-Datei senden.",
    .phone_label = "VOM HANDY",
    .waiting_phone = "Warte auf das Handy…",
    .wifi_saved = "Wi-Fi zu Hause gespeichert: %s",
    .hint_setup = "Home: zurück",
    .update_notice = "Neu: Vellum %s",
    .update_new = "Neu",
    .send_book = "An anderen Vellum senden",
    .send_title = "Buch senden",
    .nearby_label = "READER IN DER NÄHE",
    .looking = "Suche Reader in der Nähe… Auf dem anderen Vellum »Bücher hinzufügen« öffnen.",
    .sending_to = "Senden an %s",
    .sent_to = "An %s gesendet. Das Buch ist jetzt in dessen Bibliothek.",
    .send_no_answer = "Keine Antwort. Beide Reader nah beieinander halten, beim anderen »Bücher hinzufügen« öffnen.",
    .send_refused = "Der andere Reader empfängt gerade ein anderes Buch.",
    .send_card_full = "Die Speicherkarte des anderen Readers ist voll.",
    .send_corrupt = "Das Buch kam beschädigt an. Erneut versuchen.",
    .send_unreadable = "Dieses Buch konnte nicht von der Karte gelesen werden.",
    .hint_send = "Seitentasten: wählen · Power: senden · Home: zurück",
    .hint_sending = "Home: abbrechen",
    .hint_sent = "Power: zurück zum Buch",
    .hint_retry = "Power: erneut versuchen · Home: zurück",
    .peer_hint = "Ein anderer Vellum in der Nähe kann auch Bücher senden: im Buch Inhalt › An anderen Vellum senden öffnen.",
    .store_link = "Kostenlose Bücher",
    .store_search_for = "Kostenlose Bücher nach »%s« durchsuchen",
    .store_title = "Kostenlose Bücher",
    .store_lead = "Klassiker, kostenlos, über Wi-Fi zu Hause",
    .store_demo = "Demo-Katalog: Der Simulator hat kein Internet",
    .store_abouts = {"Über 70.000 Klassiker, viele Sprachen", "Sorgfältig gestaltete Klassiker-Ausgaben"},
    .store_lists = {"Am beliebtesten", "Neu hinzugefügt", "Auf Litauisch", "Abenteuer", "Krimis", "Science-Fiction",
                    "Für Kinder", "Lyrik", "Neuerscheinungen"},
    .store_loading = "Wird geladen…",
    .store_earlier = "Vorherige Bücher",
    .store_more = "Weitere Bücher",
    .store_empty = "Hier sind keine Bücher.",
    .store_no_epub = "Dieses Buch hat kein EPUB zum Herunterladen.",
    .store_download = "Herunterladen",
    .store_downloading = "Wird geladen… %d%%",
    .store_saved = "In der Bibliothek gespeichert.",
    .store_read_now = "Jetzt lesen",
    .store_back = "Zurück zur Liste",
    .store_retry = "Erneut versuchen",
    .store_no_home_wifi = "Kein Wi-Fi zu Hause eingerichtet. Festlegen unter Einstellungen › Updates › Wi-Fi zu Hause.",
    .store_no_server = "Katalog nicht erreichbar. Später erneut versuchen.",
    .store_broke_off = "Download abgebrochen. Erneut versuchen.",
    .store_not_book = "Die Website hat etwas gesendet, das kein Buch ist.",
    .hint_store_busy = "Bitte warten…",
    .step_home = "1  IM WI-FI ZU HAUSE",
    .home_hint = "Handy oder Computer ebenfalls damit verbinden.",
    .scan_one_hint = "Oder den Code mit der Handykamera scannen.",
    .use_own_network = "Eigenes Netzwerk des Readers nutzen",
    .use_home_wifi = "Wi-Fi zu Hause nutzen: %s",
    .home_wifi_failed = "Keine Verbindung zum Wi-Fi zu Hause, daher hat der Reader sein eigenes Netzwerk geöffnet.",
    .sync_progress = "Fortschritt synchronisieren",
    .sync_busy = "Synchronisiere…",
    .sync_sent = "%d%% gesendet",
    .sync_moved = "Auf %d%% gesprungen",
    .sync_up_to_date = "Aktuell",
    .sync_errors = {"Kein Wi-Fi zu Hause", "Wi-Fi-Fehler", "Kein Server", "Falsche Anmeldung", "Name vergeben"},
    .look_up_word = "Wort nachschlagen",
    .highlights_label = "MARKIERUNGEN",
    .highlight = "Markieren",
    .remove_highlight = "Markierung entfernen",
    .close = "Schließen",
    .save = "Sichern",
    .cancel = "Abbrechen",
    .no_dictionary =
        "Noch kein Wörterbuch. StarDict-Dateien in den Ordner dictionaries auf der Karte legen oder über »Bücher "
        "hinzufügen« senden.",
    .not_in_dictionary = "Nicht im Wörterbuch.",
    .preparing_dictionary = "Wörterbuch wird vorbereitet…",
    .hint_pick_line = "Seitentasten: Zeile · Power: wählen · Home: zurück",
    .hint_pick_word = "Seitentasten: Wort · Power: nachschlagen · Home: zurück",
    .hint_extend = "Auf das letzte Wort tippen oder mit den Seitentasten hingehen.",
    .footer = "Fußzeile",
    .footer_names = {"Seitenzahl", "Restzeit im Kapitel", "Prozent gelesen"},
    .footer_left = "Noch %s im Kapitel",
    .contents_left = "Noch etwa %s im Kapitel · %s im Buch",
    .reading_stats = "Lesestatistik",
    .today_label = "HEUTE",
    .week_label = "LETZTE 7 TAGE · MINUTEN",
    .weekdays = {"Mo", "Di", "Mi", "Do", "Fr", "Sa", "So"},
    .this_month = "Diesen Monat",
    .reading_speed = "Lesetempo",
    .pages_an_hour = "%d Seiten pro Stunde",
    .all_time = "Insgesamt",
    .books_label = "BÜCHER",
    .nothing_read = "Noch nichts gelesen. Die Lesezeit erscheint hier, sobald Sie umblättern.",
    .stats_clock =
        "Die Uhr ist nicht gestellt, daher wird das Lesen nicht nach Tagen gezählt. Einmal »Bücher hinzufügen« "
        "öffnen und die Seite auf dem Handy laden: Das stellt die Uhr.",
    .preview_text =
        "Der Abend war still, und der Fluss trug die letzten Spiegelungen der Sonne langsam an den alten Weiden "
        "vorbei, während irgendwo hinter der Wiese ein Hund zweimal bellte und dann verstummte.",
    .preview_language = "de",
    .sort_by = "Sortierung: %s",
    .sort_names = {"Zuletzt", "Titel", "Autor", "Hinzugefügt"},
    .search = "Suchen",
    .search_prompt = "Titel oder Autor",
    .ok = "OK",
    .tab_all = "Alle",
    .tab_reading = "Begonnen",
    .tab_finished = "Gelesen",
    .new_shelf = "Neues Regal",
    .shelf_name = "Name des Regals",
    .rename = "Umbenennen",
    .delete_shelf = "Regal löschen",
    .delete_again = "Zum Löschen erneut drücken",
    .shelf_empty =
        "Noch keine Bücher in diesem Regal. Ein Buch unter Alle gedrückt halten oder im Inhalt eines Buchs »Zum "
        "Regal hinzufügen« wählen.",
    .nothing_found = "Keine Bücher zu »%s«.",
    .no_books_here = "Hier sind noch keine Bücher.",
    .add_to_shelf = "Zum Regal hinzufügen",
    .shelves = "Regale",
    .shelves_label = "REGALE",
    .finished_reading = "Fertig gelesen",
    .buttons = "Tasten",
    .button_pages = {"Beim Lesen", "In Menüs"},
    .input_names = {"Vorige", "Nächste", "Power", "Home", "Vorige halten", "Nächste halten", "Home halten"},
    .action_names = {"Nichts",          "Vorherige Seite", "Nächste Seite",  "Vorheriges Kapitel",
                     "Nächstes Kapitel", "Inhalt",         "Startbildschirm", "Bibliothek",
                     "Lesezeichen",     "Licht ein/aus",   "Beleuchtung",    "Auto-Blättern",
                     "Voll aktualisieren", "Bildschirmfoto", "Ruhemodus",    "Hoch",
                     "Runter",          "Öffnen",          "Zurück",         "Seite hoch",
                     "Seite runter",    "Schnellmenü"},
    .reset_default = "Standard wiederherstellen",
    .power_hold_note = "Power eine Sekunde halten startet immer den Ruhemodus.",
    .way_back_note =
        "Belegungen, die keinen Weg zum Inhalt oder Startbildschirm lassen oder kein Öffnen, Zurück und Bewegen "
        "in Menüs, werden übersprungen.",
    .screen_names = {"Hochformat", "Kopfüber", "Quer, Tasten links", "Quer, Tasten rechts"},
    .screen_note = "Bücher drehen sich quer, sobald du eines öffnest. Menüs bleiben hochkant.",
    .auto_turn = "Auto-Blättern",
    .every_seconds = "Alle %d s",
    .full_refresh = "Volle Aktualisierung",
    .refresh_names = {"Jede Seite", "Alle 5 Seiten", "Alle 12 Seiten", "Alle 20 Seiten", "Neues Kapitel"},
    .start_auto_turn = "Alle %d s umblättern",
    .auto_turn_on = "Blättert alle %d s um",
    .auto_turn_off = "Auto-Blättern beendet",
    .screenshot_saved = "%s gespeichert",
    .screenshot_failed = "Kein Bildschirmfoto: keine Karte?",
    .sleep_screen = "Ruhebildschirm",
    .sleep_kinds = {"Buchcover", "Meine Bilder", "Lesestatistik", "Schlicht", "Letzte Seite"},
    .sleep_help = {"Das Cover des Buchs, das Sie lesen.", "Eigene Bilder aus dem Ordner sleep.",
                   "Ihr Fortschritt und Ihre Lesezeit.", "Der Buchtitel auf einer ruhigen Seite.",
                   "Der letzte Bildschirm bleibt, als Ruhemodus markiert."},
    .pictures_label = "MEINE BILDER",
    .sleep_order = "Bilder",
    .sleep_order_names = {"Zufällig", "Ein Bild"},
    .choose_pictures = "Bilder auswählen",
    .preview = "Vorschau",
    .no_pictures =
        "Noch keine Bilder. JPG-, PNG- oder BMP-Dateien in den Ordner sleep auf der Karte legen oder über die "
        "Handyseite von »Bücher hinzufügen« senden.",
    .preparing_pictures = "Bilder werden vorbereitet\xE2\x80\xA6",
    .preparing_book = "Buch wird vorbereitet\xE2\x80\xA6",
    .preparing_book_once = "Nur beim ersten Hinzufügen.",
    .picture_broken = "Nicht darstellbar",
    .pictures_shuffle_lead = "Jedes Mal ein neues aus den markierten.",
    .pictures_one_lead = "Das markierte Bild erscheint jedes Mal.",
    .hint_pictures_shuffle = "Seitentasten: wählen · Power: markieren · Home: zurück",
    .hint_pictures_one = "Seitentasten: wählen · Power: auswählen · Home: zurück",
    .hint_preview = "Zum Zurückkehren eine Taste drücken",
    .now_reading = "AKTUELLE LEKTÜRE",
    .last_7_days = "LETZTE 7 TAGE",
    .finished_label = "GELESEN",
    .left_in_book = "Noch %s",
    .library_view = "Ansicht Start & Bibliothek",
    .view_names = {"Liste", "Cover"},
    .recent_label = "ZULETZT GELESEN",
    .move_finished = "Gelesene Bücher verschieben",
    .move_names = {"Aus", "Nach Read/"},
    .folders = "Ordner",
    .card_root = "Speicherkarte",
    .folder_up = "Eine Ebene höher",
    .folder_empty = "Keine Bücher oder Bilder in diesem Ordner.",
    .picture_failed = "Dieses Bild kann nicht angezeigt werden.",
    .hint_picture = "Seitentasten: nächstes Bild · Home: zurück",
    .night_mode = "Nachtmodus",
    .focus_reading = "Fokus-Lesen",
    .book_styles = "Verlagsstile",
    .paragraph_indent = "Absatzeinzug",
    .indent_names = {"Wie im Buch", "Immer", "Nie"},
    .go_to = "Gehe zu…",
    .go = "Los",
    .hint_go_coarse = "Seitentasten ±10% · Power: feiner · Home: abbrechen",
    .hint_go_fine = "Seitentasten ±1% · Power: los · Home: abbrechen",
    .links_on_page = "Links auf dieser Seite",
    .hint_pick_link = "Seitentasten: Link wählen · Power: öffnen",
    .back_to_page = "Zurück zur vorherigen Stelle",
    .note = "Anmerkung",
    .finished_question = "Buch fertig gelesen?",
    .mark_read = "Als gelesen markieren",
    .not_yet = "Noch nicht",
    .setup_again = "Einrichtung wiederholen",
    .setup_step = "Schritt %d von %d",
    .welcome = "Willkommen",
    .welcome_lead =
        "Richten wir ein paar Dinge ein. Alles lässt sich später in den Einstellungen ändern. Zuerst die Sprache:",
    .clock_lead = "Wie soll die Uhrzeit oben auf dem Bildschirm aussehen?",
    .menu_text_lead = "Welche Größe des Menütexts ist besser lesbar? Sie lässt sich später in den Einstellungen ändern.",
    .wifi_lead =
        "Mit dem Wi-Fi zu Hause kann sich der Reader selbst aktualisieren und Bücher laden. Das Handy richtet es "
        "ein und stellt dabei auch die Uhr.",
    .set_up_now = "Jetzt einrichten",
    .books_lead =
        "Bücher kommen per Wi-Fi vom Handy oder Computer. »Bücher hinzufügen« öffnen und den Schritten auf dem "
        "Bildschirm folgen. Es ist immer auf dem Startbildschirm zu finden.",
    .open_add_books = "»Bücher hinzufügen« öffnen",
    .skip = "Überspringen",
    .next = "Weiter",
    .hint_welcome = "Seitentasten: wählen · Power: OK · Home: zurück",
    .hint_welcome_first = "Seitentasten: wählen · Power: OK",
    .page_settings = "Seite",
    .display_light = "Anzeige & Licht",
    .sleep_battery = "Ruhemodus & Akku",
    .general = "Allgemein",
    .light_short = "Licht",
    .night_short = "Nacht",
    .home_short = "Start",
    .sleep_short = "Ruhe",
    .hint_quick = "Seitentasten: wählen · Power: OK · Home: schließen",
    .starting_back = "Doch nicht? Zurück tippen oder Home drücken.",
    .back_label = "Zurück",
    .add_books_over = "Bücher hinzufügen über",
    .network_names = {"Wi-Fi zu Hause", "Eigenes Netz"},
    .status_name = "Vellum",
    .delete_book = "Buch löschen",
    .delete_question = "Dieses Buch löschen?",
    .delete_note =
        "Das Buch wird mit Lesestelle, Lesezeichen und Markierungen von der Speicherkarte entfernt. Das lässt sich nicht rückgängig machen.",
    .delete_yes = "Ja, löschen",
    .delete_no = "Nein, behalten",
    .delete_failed = "Buch konnte nicht gelöscht werden",
